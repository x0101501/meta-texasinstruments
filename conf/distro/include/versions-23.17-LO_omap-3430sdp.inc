## conf/distro/include/versions-23.17-LO_omap-3430sdp.inc
```bitbake
# omap3430 SDP specific versions

# baseport
PREFERRED_VERSION_x-load =             "4.62"
PREFERRED_VERSION_u-boot =             "5.10"
SRCREV_pn-linux-tiomap ?= "5cd99ca3df1d8a84a1abf134c4ec3e7065f9a985"
```

## conf/distro/include/versions-23.17-LO_omap-3630sdp.inc
```bitbake
# omap3630 SDP specific versions

# baseport
SRCREV_pn-x-load ?= "e25a588b5628238ba1b225cdfb6f320122850ad0"
SRCREV_pn-u-boot ?= "b78da33ccaf32720cfc1d347d654a546098f5043"
```

## conf/distro/include/versions-23.17-LO_zoom2.inc
```bitbake
# Zoom2 specific versions

# baseport
SRCREV_pn-x-load ?= "8422b561fbd750ccb852f89904bbb9c39e2fac7a"
SRCREV_pn-u-boot ?= "4edcb22171155ccf615d4b9ee4800606651dc623"
SRCREV_pn-linux-tiomap ?= "f1cc27d4e30cc7e33dfb50b52dbe1e844218c4dc"
```

## conf/distro/include/versions-23.17-P1-LO_omap-3430sdp.inc
```bitbake
# omap3430 SDP specific versions

# baseport
PREFERRED_VERSION_x-load =             "4.62"
PREFERRED_VERSION_u-boot =             "5.10"
```

## conf/distro/include/versions-23.17-P1-LO_omap-3630sdp.inc
```bitbake
# omap3630 SDP specific versions

# baseport
SRCREV_pn-x-load ?= "e160c3806808a27e999f5c9400e77ce45bb87bc2"
SRCREV_pn-u-boot ?= "1929718c09ce5090641b36bbd0f684e2098f2d66"
```

## conf/distro/include/versions-23.17-P1-LO_zoom2.inc
```bitbake
# Zoom2 specific versions

# baseport
SRCREV_pn-x-load ?= "8422b561fbd750ccb852f89904bbb9c39e2fac7a"
SRCREV_pn-u-boot ?= "4edcb22171155ccf615d4b9ee4800606651dc623"
SRCREV_pn-linux-tiomap ?= "cfa0d58e2adf3ae5bebf637401b1d252d87157c3"
```

## conf/distro/include/versions-23.17-P1-LO_zoom3.inc
```bitbake
# omap3630 zoom3 specific versions

# baseport
SRCREV_pn-x-load ?= "eb6c1e2fad0decfc4c54dfc226f859e0715c1518"
SRCREV_pn-u-boot ?= "2f48771a689dd27af39c00984ede680e8db2ed36"
```
